## zephyr/boards/xiao_nrf54l15_nrf54l15_cpuapp.conf
```kconfig
# Adjust memory for nRF54L15
CONFIG_HEAP_MEM_POOL_SIZE=8192
CONFIG_MAIN_STACK_SIZE=4096

# nRF54L15 has no USB hardware - disable USB and use RTT for console
CONFIG_USB_DEVICE_STACK=n
CONFIG_USB_CDC_ACM=n
CONFIG_USE_SEGGER_RTT=y
CONFIG_RTT_CONSOLE=y

# XIAO nRF54L15 v1.0 hardware issue: UART20 is wired through the SAMD11
# CMSIS-DAP chip (USB-UART bridge) which is only powered when USB is
# connected.  With CONFIG_UART_CONSOLE=y Zephyr's SYS_INIT tries to
# initialise UART20 before main() runs; without VBUS the init hangs and
# the MCU never reaches application code - no LEDs, no BLE advertising.
# Disabling UART console and its log backend, and routing logging to RTT
# instead, allows the firmware to boot from the RadPro 3 V supply alone.
# See: docs/reference/xiao_nrf54l15_wiki.md lines 1036-1099
CONFIG_UART_CONSOLE=n
CONFIG_LOG_BACKEND_UART=n
CONFIG_LOG_BACKEND_RTT=y
```
